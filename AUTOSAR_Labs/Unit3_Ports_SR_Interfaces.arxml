AUTOSAR XML (schema 00047)
package /SR_Interfaces_Lab
  sender receiver interface SRI1
    data VAR1: sw-impl-policy=QUEUED, type=uint16, init-value=18
    data VAR2: sw-impl-policy=QUEUED, type=uint32, init-value=12
  application sw component type SWC1
    provide port P_Port1: provided-interface=SRI1
  application sw component type SWC2
    require port R_Port1: required-interface=SRI1
