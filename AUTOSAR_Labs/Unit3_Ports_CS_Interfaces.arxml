AUTOSAR XML (schema 00047)
package /CS_Interfaces
  client server interface CS_IF_sum
    operation Sum
      arg IN1: type=uint16, direction=IN
      arg IN2: type=uint16, direction=IN
      arg RES: type=uint32, direction=OUT
  application sw component type SWC_Server
    provide port Server_P_PORT_SUM: client-server-annotation=Sum
  application sw component type SWC_Client
    require port Client_P_PORT_SUM: client-server-annotation=Sum
