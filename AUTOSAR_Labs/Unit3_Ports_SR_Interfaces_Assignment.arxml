AUTOSAR XML (schema 00047)
package /SR_Interfaces_Assignment
  sender receiver interface SRI_LIDAR
    data ObjectDistance: sw-impl-policy=QUEUED, type=uint32, init-value=15
  sensor actuator sw component type LIDAR
    provide port LIDAR_P_PORT1: provided-interface=SRI_LIDAR
  application sw component type LIDAR_Algo
    require port LIDAR_Algo_R_Port1: required-interface=SRI_LIDAR
